#include <MaxMatrix.h>
#include <avr/pgmspace.h>
int data = 7;    // SPI MOSI к DIN модуля MAX7219
int clock = 5;  // SPI CLK к CLK модуля MAX7219
int load = 4;    // SPI NSS к CS модуля MAX7219
int speeds = 200; //скорость бегущей строки
int brightness = 1; //яркость от 0 до 15
int maxInUse = 3;    //количество модулей MAX7219
int lendig = 7; //размер одного символа в массиве
int flag_s = 0;
char string1[] = " ё;ё:н:о"; //текст бегущей строки
PROGMEM prog_uchar CH[] = {
3, 8,  B00000000,  B00000000,  B00000000,  B00000000,  B00000000,  //  space
1, 8,  B01011111,  B00000000,  B00000000,  B00000000,  B00000000,  //  !
3, 8,  B00000011,  B00000000,  B00000011,  B00000000,  B00000000,  //  "
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4, 8,  B00111001,  B01010100,  B01010100,  B01001001,  B00000000,  //  ё


};



MaxMatrix m(data, load, clock, maxInUse);
byte buffer[10];
void setup(){
  m.init();
  m.setIntensity(brightness);
  Serial.begin(9600);
}

void loop(){
/*
  while (Serial.available() > 0){
    byte c = Serial.read();
    printCharWithShift(c, speeds);
  }
  m.shiftLeft(false, true);
  */
 printStringWithShift(string1, speeds);
}

void printCharWithShift(char c, int shift_speed){
  if (c < 32) return;
  if (c == 129 && flag_s == 1) c = 192;
  if (c == 145 && flag_s == 2) c = 193;
  if (c > 207) {
     if (c == 208) flag_s=1;
     if (c == 209) flag_s=2; 
    return;
  } else {
    flag_s=0;
  }
  c -= 32;
  memcpy_P(buffer, CH + lendig*c, lendig);
  m.writeSprite(32, 0, buffer);
  m.setColumn(32 + buffer[0], 0);
  
  for (int i=0; i<buffer[0]+1; i++) 
  {
    delay(shift_speed);
    m.shiftLeft(false, false);
  }
}

void printStringWithShift(char* s, int shift_speed){
  while (*s != 0){
    printCharWithShift(*s, shift_speed);
    s++;
  }
}

void printString(char* s)
{
  int col = 0;
  while (*s != 0)
  {
    if (*s < 32) continue;
    char c = *s - 32;
    memcpy_P(buffer, CH + lendig*c, lendig);
    m.writeSprite(col, 0, buffer);
    m.setColumn(col + buffer[0], 0);
    col += buffer[0] + 1;
    s++;
  }
}
